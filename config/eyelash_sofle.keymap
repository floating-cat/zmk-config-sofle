#define CONFIG_WIRELESS
#define ZMK_BASE_LAYER(name, LT, RT, LM, RM, LB, RB, LH, RH)                                                      \
    ZMK_LAYER(                                                                                                    \
        name,                                                                                                     \
        &kp ESC    &kp N1 &kp N2 &kp N3 &kp N4 &kp N5  &kp UP    &kp N6 &kp N7 &kp N8 &kp N9 &kp N0     &kp BSPC  \
        &kp TAB                      LT                &kp DOWN                  RT                     &kp BSLH  \
        &sk LCTRL                    LM                &kp LEFT                  RM                     &kp APOS  \
        &sk LSHFT                    LB                &kp RIGHT                 RB                     &kp GRAVE \
        &kp C_MUTE XXX XXX &sk LALT  LH                &kp ENTER                 RH &smart_rshft XXX XXX          \
        ,&inc_dec_kp C_VOL_UP C_VOL_DN &inc_dec_kp C_VOL_UP C_VOL_DN                                              )

#include "key-labels-eyelash-sofle-64.h"
#include "base.keymap"
